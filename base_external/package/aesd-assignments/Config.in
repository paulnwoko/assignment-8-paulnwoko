## base_external/package/aesd-assignments/Config.in
```kconfig
config BR2_PACKAGE_AESD_ASSIGNMENTS
	bool "aesd-assignments"
	help
	  Build and install aesdsocked server and init script.
	  Used to understand buildroot external trees and package builds.
```
